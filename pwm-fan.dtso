/dts-v1/;
/plugin/;

/ {
    fragment@1 {
        target = <&pwm1>;
        __overlay__ {
            pinctrl-0 = <&pwm1m2_pins>;
            pinctrl-names = "default";
            status = "okay";
        };
    };
};